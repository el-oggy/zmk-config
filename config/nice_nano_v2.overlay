/ {
    kscan0: kscan {
        compatible = "zmk,kscan-gpio-matrix";

        diode-direction = "row2col";

        row-gpios
            = <&gpio0 8 GPIO_ACTIVE_LOW>;

        col-gpios
            = <&gpio0 18 (GPIO_PULL_UP | GPIO_ACTIVE_LOW)>;
    };
};